VERSION "1.0"

NS_ :

BS_:

BU_: ECU1 ECU2

BO_ 100 EngineData: 8 ECU1
 SG_ EngineSpeed : 0|16@1+ (0.125,0) [0|8000] "rpm" ECU2
 SG_ VehicleSpeed : 16|8@1+ (1,0) [0|255] "km/h" ECU2
